#include <dt-bindings/pinctrl/samd21-da1gXabcd-pinctrl.h>
#include <zephyr/dt-bindings/i2c/i2c.h> 

/{
    zephyr,user {
		io-channels = <&adc 7>;
	};
};

&adc {
    #address-cells = <1>;
    #size-cells = <0>;
    channel@7 {
		reg = <7>;
		zephyr,gain = "ADC_GAIN_1";
		zephyr,reference = "ADC_REF_INTERNAL";
		zephyr,acquisition-time = <ADC_ACQ_TIME_DEFAULT>;
		zephyr,resolution = <12>;
		zephyr,input-positive = <7>;
	};
};